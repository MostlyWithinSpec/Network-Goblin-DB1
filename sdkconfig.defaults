## sdkconfig.defaults
```kconfig
CONFIG_IDF_TARGET="esp32c2"
# this board uses a 26 MHz crystal (stock ESP-IDF default for C2 is 40 MHz)
CONFIG_XTAL_FREQ_26=y
CONFIG_ESPTOOLPY_FLASHSIZE_4MB=y
CONFIG_PARTITION_TABLE_CUSTOM=y
CONFIG_PARTITION_TABLE_CUSTOM_FILENAME="partitions.csv"
CONFIG_BOOTLOADER_APP_ROLLBACK_ENABLE=y
CONFIG_ESP_MAIN_TASK_STACK_SIZE=4096
CONFIG_HTTPD_MAX_REQ_HDR_LEN=1024
CONFIG_HTTPD_MAX_URI_LEN=256
CONFIG_COMPILER_OPTIMIZATION_SIZE=y
CONFIG_LWIP_MAX_SOCKETS=12
CONFIG_ESP_WIFI_STATIC_RX_BUFFER_NUM=6
CONFIG_ESP_WIFI_DYNAMIC_RX_BUFFER_NUM=16
CONFIG_ESP_WIFI_DYNAMIC_TX_BUFFER_NUM=16
CONFIG_FREERTOS_HZ=1000
```
